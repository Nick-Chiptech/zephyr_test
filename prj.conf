## CMakeLists.txt
```
# SPDX-License-Identifier: Apache-2.0

cmake_minimum_required(VERSION 3.20.0)
find_package(Zephyr REQUIRED HINTS $ENV{ZEPHYR_BASE})
project(nicks_test)
target_sources(app PRIVATE src/main_small.c)
```

## west.yml
```
# In your custom west.yml file (e.g., in your main app's repo)

manifest:
  # ... other manifest sections ...

  remotes:
    - name: github
      url-base: git@github.com:mpaland

  projects:
    # ... existing projects from inherited manifests ...
    - name: printf
      path: submodules/printf
      remote: github # Reference the remote defined above
```

## prj.conf
```kconfig
CONFIG_GPIO=y
CONFIG_SHELL=y
CONFIG_LOG=y
CONFIG_LOG_CMDS=y
CONFIG_LOG_RUNTIME_FILTERING=y
```

## src/main_small.c
```c
/*
 * Copyright (c) 2016 Intel Corporation
 *
 * SPDX-License-Identifier: Apache-2.0
 */

#include <stdio.h>
#include <zephyr/kernel.h>
#include <zephyr/drivers/gpio.h>

#define SLEEP_TIME_MS   1000
#define LED0_NODE DT_ALIAS(led0)

const struct gpio_dt_spec bled = GPIO_DT_SPEC_GET(LED0_NODE, gpios);

int main(void)
{
    int rc;
	if (!gpio_is_ready_dt(&bled)) {return 0;}
	rc = gpio_pin_configure_dt(&bled, GPIO_OUTPUT_ACTIVE);
	if (rc < 0) return rc;

	while (1) 
    {
      rc = gpio_pin_toggle_dt(&bled);
      if (rc < 0)  return rc;
      k_msleep(SLEEP_TIME_MS);
	}
	return 0;
}
```
